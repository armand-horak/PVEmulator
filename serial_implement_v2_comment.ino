#include <driver/adc.h>

hw_timer_t *My_timer = NULL;

boolean flag = 0;
int done = 1;
unsigned long time1;
unsigned long time2;
char buf1[50];
char buf2[50];
float voltage;
float current;
float serial_data;
unsigned char serial_buffer[2048];
float params[6];
int count = 0;
int voltage_bool = 1;

#define PWM1_Ch    0
#define PWM1_Res   8
#define PWM1_Freq  25000
#define PWM_GPIO   5

int PWM1_DutyCycle = 0;
const int VoutPin = 34;
const int IoutPin = 35;
uint32_t  vout = 0;
uint32_t  iout = 0;
float volts = 0;
float amps = 0;
float resistance = 0;

float error_pi = 0;
float out_pi = 0;
float error_prev_pi = 0;
float out_prev_pi = 0;
int count_data = 0;
int loop_count = 0;

float lookup_r[][4] = {{ 0.1 , 3.182003764649863e-05 , 5.385891835020972 , 0 } ,
{ 0.2 , 4.745893011767705e-05 , 5.163930416616863 , 0 } ,
{ 0.3 , 5.0099520417181885e-05 , 5.364516791593784 , 0 } ,
{ 0.4 , 4.6613038411378945e-05 , 6.0615885847770095 , 0 } ,
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{ 99.9 , 1.465557543291911e-07 , 3.6284720820855902 , 0 } };

int r_length = trunc(sizeof(lookup_r) / sizeof(lookup_r[0]));
float Tfull = 1e-03;
float Thalf = (Tfull) / 2;
float volts_prev = 0;
float volts_meas_prev = 0;
float volts_meas = 0;
float amps_prev = 0;
float amps_meas_prev = 0;
float amps_meas = 0;
float Vref = 0;
float search = 0;
float y_v = 0;
float y_i = 0;
float b_v = 1 - 0.85;
float b_i = 1 - 0.85;
float Kp = 0;
float Ki = 0;

void IRAM_ATTR onTimer(){
  done = 0;
}

void send_float (float arg)
{
  // get access to the float as a byte-array:
  byte * data = (byte *) &arg; 

  // write the data to the serial
 Serial.write(data, sizeof (arg));
}

void setup() {
  Serial.begin(115200);
  ledcAttachPin(PWM_GPIO, PWM1_Ch);
  ledcSetup(PWM1_Ch, PWM1_Freq, PWM1_Res);
}

void loop() {
  if ((Serial.available() > 0) &&  (voltage_bool == 1))
  {
    if ((Serial.readBytes(serial_buffer, sizeof(float)) == sizeof(float)))
    {
      memcpy(&serial_data, serial_buffer, sizeof(float));
    }
    else
    {
      serial_data = 0;
    }
    send_float(serial_data);      
    lookup_r[count_data][3] = serial_data;
    count_data++;
    if((int)serial_data == 1111)
    {
      voltage_bool = 0;
      send_float(voltage_bool);    
      delay(500);
      My_timer = timerBegin(1, 80, true); //divide by prescaler
      timerAttachInterrupt(My_timer, &onTimer, true);
      timerAlarmWrite(My_timer, Tfull*1000000, true); //microseconds
      timerAlarmEnable(My_timer); //Just Enable
      y_v = 0;
      y_i = 0;
      count = 0;
    }
  }
  if(voltage_bool == 0){ 
    PWM1_DutyCycle  = trunc((1 - out_pi) * 255);
    ledcWrite(PWM1_Ch, PWM1_DutyCycle);
    vout = vout + analogReadMilliVolts(VoutPin);
    iout = iout + analogReadMilliVolts(IoutPin);
    count++;

    if(done==0 ){
      loop_count++;
      y_v += b_v * (vout / count - y_v);
      y_i += b_i * (iout / count - y_i) ;
      amps = (y_i) * 0.006548707  - 0.578371975;
      volts = (y_v) * 0.034586093 - 1.739208387;
      volts_meas = volts_meas + volts;
      amps_meas = amps_meas + amps;
      resistance = volts / amps;
      search = resistance;
      
      int first = 0;
      int last = r_length - 1;
      int middle = 0;
      while( first <= last )
      {
        middle = (first + last) / 2;
        if ( lookup_r[middle][0] == search) break;
        if ( lookup_r[middle][0] < search )
          first = middle + 1;    
        else
          last = middle - 1;
      }
      Kp = lookup_r[middle][1];
      Ki = lookup_r[middle][2];
      Ki = Ki / 10;
      Vref = lookup_r[middle][3];
      error_pi = Vref - volts;
      
      if(volts < 2.5){
        out_pi = out_prev_pi + (Kp) * error_pi;
      }   
      else { 
        out_pi = out_prev_pi + (Kp + Ki * Thalf) * error_pi + (Ki * Thalf - Kp) * error_prev_pi;      
      }

      out_prev_pi = out_pi;
      error_prev_pi = error_pi;
     
      if(out_pi > 0.9){
        out_pi = 0.9;
      }
      if(out_pi < 0.025){
        out_pi = 0.025;
      }
      count = 0;
      vout = 0;
      iout = 0;
      done = 1;
    }
    
    if(loop_count == 250){
      gcvt(volts_meas / 250, 4, buf1);
      gcvt(amps_meas / 250, 4, buf2);
      
      strcat(buf1, "#");
      strcat(buf1, buf2);
      strcat(buf1, "\n");
      Serial.write(buf1);
      
      volts_meas = 0;
      amps_meas = 0;
      loop_count = 0;
    }
  }
}
